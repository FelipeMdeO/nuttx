## arch/arm/src/ht32f491x3/Kconfig
```kconfig
#
# For a description of the syntax of this configuration file,
# see the file kconfig-language.txt in the NuttX tools repository.
#

comment "HT32F491x3 Configuration Options"

choice
	prompt "HT32F491x3 Chip Selection"
	default ARCH_CHIP_HT32F49163
	depends on ARCH_CHIP_HT32F491X3

config ARCH_CHIP_HT32F49153
	bool "HT32F49153"
	select ARCH_HAVE_CUSTOM_VECTORS
	---help---
		128 KiB FLASH, 48 KiB SRAM.

config ARCH_CHIP_HT32F49163
	bool "HT32F49163"
	select ARCH_HAVE_CUSTOM_VECTORS
	---help---
		256 KiB FLASH, 48 KiB SRAM.

endchoice

config HT32F491X3_SYSCLK_FREQUENCY
	int "System clock frequency"
	default 8000000
	range 1 150000000
	depends on ARCH_CHIP_HT32F491X3
	---help---
		The reset clock tree runs from the 8 MHz HICK oscillator. Adjust
		this if board-specific CRM/PLL setup changes SYSCLK before the
		generic timer or serial logic runs.

config HT32F491X3_PCLK1_FREQUENCY
	int "APB1 clock frequency"
	default HT32F491X3_SYSCLK_FREQUENCY
	range 1 150000000
	depends on ARCH_CHIP_HT32F491X3
	---help---
		APB1 clock used by USART2 and USART3. The default matches the reset
		configuration where APB1DIV does not divide HCLK.

config HT32F491X3_PCLK2_FREQUENCY
	int "APB2 clock frequency"
	default HT32F491X3_SYSCLK_FREQUENCY
	range 1 150000000
	depends on ARCH_CHIP_HT32F491X3
	---help---
		APB2 clock used by USART1. The default matches the reset
		configuration where APB2DIV does not divide HCLK.

menu "Peripheral Support"

config HT32F491X3_TMR3
	bool "TMR3"
	default n
	---help---
		Enable support for the TMR3 peripheral.

config HT32F491X3_TMR3_PWM
	bool "TMR3 PWM output"
	default n
	depends on HT32F491X3_TMR3 && PWM
	---help---
		Use TMR3 as the lower-half PWM device.

config HT32F491X3_TMR3_CHANNEL
	int "TMR3 PWM channel"
	default 1
	range 1 4
	depends on HT32F491X3_TMR3_PWM
	---help---
		Select which TMR3 channel is exposed as /dev/pwm0.
		Channel-to-pin mapping on the esk32 board:
		  1 -> PA6
		  2 -> PA7
		  3 -> PB0
		  4 -> PB1

config HT32F491X3_USART1_SERIALDRIVER
	bool "USART1"
	default y
	select USART1_SERIALDRIVER
	select ARCH_HAVE_SERIAL_TERMIOS
	---help---
		Enable the standard lower-half driver for USART1.

comment "In this current version, only USART1 is exposed by the esk32 board support."

comment "PWM output is currently supported through TMR3 channels PA6/PA7/PB0/PB1."

endmenu # "Peripheral Support"
```
